## config/boards/shields/marvtsey/Kconfig.shield
```kconfig
# Copyright (c) 2021 Mike "KemoNine" Crosson
# SPDX-License-Identifier: MIT

config SHIELD_MARVTSEY
	def_bool $(shields_list_contains,marvtsey)
```
